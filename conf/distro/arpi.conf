## conf/distro/arpi.conf
```bitbake
require conf/distro/poky.conf

DISTROOVERRIDES = "poky"

DISTRO = "arpi"
DISTRO_NAME = "Arduino powered PI"
DISTRO_VERSION = "0.0.1"
DISTRO_CODENAME = "arpi"
MAINTAINER = "MH"

# Append and remove features
DISTRO_FEATURES_append = " wifi"
#DISTRO_FEATURES_remove = " XXX"

# SystemD

#DISTRO_FEATURES_append = " systemd"
#DISTRO_FEATURES_BACKFILL_CONSIDERED += "sysvinit"
#VIRTUAL-RUNTIME_init_manager = "systemd"
#VIRTUAL-RUNTIME_initscripts = "systemd-compat-units"
PREFERRED_VERSION_linux-raspberrypi = "4.1%"

# Set IMGDEPLOYDIR for sdcard image on raspberry pi
IMGDEPLOYDIR = "${DEPLOY_DIR_IMAGE}"

# Boot config:
ENABLE_UART_raspberrypi3 := "1"
ENABLE_I2C_raspberrypi3 := "1"

# Other Settings

INHERIT += "buildhistory"
BUILDHISTORY_COMMIT = "1"
```

## conf/distro/arpi_systemd.conf
```bitbake
require conf/distro/arpi.conf

DISTRO = "arpi_systemd"
DISTRO_NAME = "Arduino powered PI (systemd)"
DISTRO_VERSION = "0.0.1"
DISTRO_CODENAME = "arpi_sysd"

DISTRO_FEATURES_append = " systemd "
DISTRO_FEATURES_BACKFILL_CONSIDERED += "sysvinit"
VIRTUAL-RUNTIME_init_manager = "systemd"
VIRTUAL-RUNTIME_initscripts = "systemd-compat-units"
PACKAGECONFIG_append_pn-systemd = " networkd resolved gcrypt"

# Remove 'debug' as it causes troubles with systemd
CMDLINE_DEBUG := ""
```

## conf/distro/arpi_uboot.conf
```bitbake
require conf/distro/arpi.conf

DISTRO = "arpi_uboot"
DISTRO_VERSION = "0.0.1"
DISTRO_CODENAME = "arpiu"

# Force u-boot creation
KERNEL_IMAGETYPE = "uImage"
```

## conf/layer.conf
```bitbake
# We have a conf and classes directory, add to BBPATH
BBPATH .= ":${LAYERDIR}"

# We have recipes-* directories, add to BBFILES
BBFILES += "${LAYERDIR}/recipes-*/*/*.bb \
	${LAYERDIR}/recipes-*/*/*.bbappend"

BBFILE_COLLECTIONS += "repeater"
BBFILE_PATTERN_repeater = "^${LAYERDIR}/"
BBFILE_PRIORITY_repeater = "10"
```
